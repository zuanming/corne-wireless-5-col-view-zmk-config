/ {
    chosen {
        zmk,display = &ssd1306;
    };
};

&i2c1 {
    compatible = "nordic,nrf-twi";
    status = "okay";
    clock-frequency = <I2C_BITRATE_400K>;

    ssd1306: ssd1306@3c {
        compatible = "solomon,ssd1306fb";
        reg = <0x3c>;
        label = "SSD1306";
        width = <128>;
        height = <64>;
        segment-offset = <0>;
        reset-gpios = <&gpio0 10 0>;  // Adjust this if not using reset
        framebuffer-refresh = <30>;
    };
};
