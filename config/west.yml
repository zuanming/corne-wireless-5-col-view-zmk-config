## config/west.yml
```yaml
manifest:
  remotes:
    - name: zmkfirmware
      url-base: https://github.com/zmkfirmware
    - name: zuanming
      url-base: https://github.com/zuanming
    - name: englmaxi
      url-base: https://github.com/englmaxi
      
  projects:
    - name: zmk
      remote: zmkfirmware
      revision: main
      import: app/west.yml
    - name: zmk-oled-adapter
      remote: zuanming
      revision: main
    - name: zmk-nice-oled
      remote: zuanming
      revision: main
    - name: zmk-dongle
      remote: zuanming
      revision: main
    - name: zmk-dongle-display
      remote: englmaxi
      revision: main
  self:
    path: config
```
